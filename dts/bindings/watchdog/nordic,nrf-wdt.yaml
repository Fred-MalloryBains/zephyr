## dts/bindings/watchdog/nordic,nrf-wdt.yaml
```yaml
# Copyright (c) 2018, Nordic Semiconductor ASA
# SPDX-License-Identifier: Apache-2.0

description: Nordic nRF family WDT (Watchdog Timer)

compatible: "nordic,nrf-wdt"

include: base.yaml

properties:
  reg:
    required: true

  interrupts:
    required: true

  opt-pause-in-sleep:
   type: boolean
   description: |
      If true, the watchdog timer will be paused when the CPU is in sleep mode.
      This is useful to prevent the watchdog from triggering during low-power
      states.

  opt-pause-halted-by-dbg:
    type: boolean
    description: |
      If true, the watchdog timer will be paused when the CPU is halted by a
      debugger. This allows the watchdog to be used during debugging without
      triggering a reset.
```

## tests/drivers/watchdog/wdt_error_cases/dts/bindings/test-wdt-errors-case.yaml
```yaml
#
# Copyright (c) 2025 Nordic Semiconductor ASA
#
# SPDX-License-Identifier: Apache-2.0
#

description: |
    This binding provides resources required to build and run the
    tests/drivers/watchdog/wdt_error_cases test in Zephyr.

compatible: "test-wdt-errors-case"

properties:
  opt-pause-in-sleep:
    type: boolean
    description: |
      If true, the watchdog timer will be paused when the CPU is in sleep mode.
      This is useful to prevent the watchdog from triggering during low-power
      states.
  opt-pause-halted-by-dbg:
    type: boolean
    description: |
      If true, the watchdog timer will be paused when the CPU is halted by a
      debugger. This allows the watchdog to be used during debugging without
      triggering a reset.
```

/*
 * Copyright (c) 2025 Nordic Semiconductor ASA
 *
 * SPDX-License-Identifier: Apache-2.0
 */

/ {
    resources {
        compatible = "test-wdt-errors-case";
        opt-pause-in-sleep;
        opt-pause-halted-by-dbg;
    };
};